## boards/waveshare_esp32_s3_touch_lcd_5/screen/product_800x480/sdkconfig.defaults
```kconfig
CONFIG_IDF_TARGET="esp32s3"
CONFIG_ESPTOOLPY_FLASHSIZE_16MB=y
CONFIG_ESP_DEFAULT_CPU_FREQ_MHZ_240=y
CONFIG_PARTITION_TABLE_CUSTOM=y
CONFIG_PARTITION_TABLE_CUSTOM_FILENAME="partitions.csv"
CONFIG_ESP_TASK_WDT_EN=y
CONFIG_ESP_TASK_WDT_TIMEOUT_S=5
CONFIG_LOG_DEFAULT_LEVEL_INFO=y
CONFIG_LWIP_MAX_SOCKETS=16
CONFIG_SPIRAM=y
CONFIG_SPIRAM_MODE_OCT=y
CONFIG_SPIRAM_SPEED_80M=y
CONFIG_SPIRAM_USE_MALLOC=y
CONFIG_SPIRAM_MALLOC_ALWAYSINTERNAL=4096
CONFIG_SPIRAM_MALLOC_RESERVE_INTERNAL=65536
CONFIG_SPIRAM_TRY_ALLOCATE_WIFI_LWIP=y
CONFIG_FREERTOS_TASK_CREATE_ALLOW_EXT_MEM=y
CONFIG_ESP_MAIN_TASK_STACK_SIZE=8192
# CONFIG_LCD_RGB_RESTART_IN_VSYNC is not set
CONFIG_HTTPD_MAX_REQ_HDR_LEN=1024
CONFIG_HTTPD_MAX_URI_LEN=256
# No build-time Wi-Fi SSID or password is embedded in this product target.
# CONFIG_PVDG_APPLY_BUILD_WIFI_PROVISIONING is not set
CONFIG_FREERTOS_HZ=1000
CONFIG_MDNS_PREDEF_NETIF_STA=y
CONFIG_MDNS_PREDEF_NETIF_AP=y
CONFIG_MDNS_PREDEF_NETIF_ETH=n
CONFIG_MDNS_MAX_INTERFACES=2
CONFIG_MDNS_MAX_SERVICES=2
```

## main/Kconfig.projbuild
```kconfig
menu "Automatrix PV-DG Controller"

config PVDG_DEVICE_NAME
    string "Controller device name"
    default "Automatrix PV-DG Controller"

config PVDG_PRIMARY_WIFI_SSID
    string "Primary Wi-Fi SSID"
    default ""

config PVDG_PRIMARY_WIFI_PASSWORD
    string "Primary Wi-Fi password"
    default ""

config PVDG_DEFAULT_WIFI_SSID
    string "Default fallback Wi-Fi SSID"
    default ""

config PVDG_DEFAULT_WIFI_PASSWORD
    string "Default fallback Wi-Fi password"
    default ""

config PVDG_APPLY_BUILD_WIFI_PROVISIONING
    bool "Allow this build to replace stored Wi-Fi credentials"
    default n
    help
      Factory/development-only provisioning gate. Leave disabled for normal,
      field, customer, resale and unattended builds. When disabled, compiled
      credentials can never replace a commissioned device's stored Wi-Fi or
      static-IP configuration.

config PVDG_WIFI_PROVISION_ID
    int "Wi-Fi provisioning id"
    default 0
    help
      Factory provisioning generation. It is considered only when
      PVDG_APPLY_BUILD_WIFI_PROVISIONING is explicitly enabled. Each approved
      factory credential set must use a strictly increasing positive value.

config PVDG_DEFAULT_ZLAN_HOST
    string "Default ZLAN5143D IP address"
    default "192.168.100.200"

config PVDG_DEFAULT_ZLAN_PORT
    int "Default ZLAN5143D Modbus TCP port"
    range 1 65535
    default 502

config PVDG_BENCH_ENGINEERING_AUTH_BYPASS
    bool "Bench-only: skip Engineering authentication on every protected HTTP API"
    default n
    help
        BENCH/DEVELOPMENT ONLY. When enabled, engineering_auth_is_authorized()
        always returns true, so every Engineering-gated HTTP endpoint (meter
        config, inverter config, Wi-Fi config, source commissioning, etc.)
        answers as if a valid session were already present, regardless of
        password or cookie.

        This must be 'n' for any build that is reachable outside a closed
        bench network -- it removes the check entirely rather than embedding
        a known credential, so there is no password to even rotate. The
        runtime logs a loud warning on every boot and on every request this
        lets through. Leave disabled for production, field, customer, resale
        and unattended builds.

config PVDG_BENCH_ENGINEERING_PASSWORD_RESET
    bool "Bench-only: expose an HTTP endpoint that erases the Engineering password"
    default n
    help
        BENCH/DEVELOPMENT ONLY. Adds POST /api/engineering/bench-reset, which
        erases the persisted Engineering password (NVS namespace eng_auth)
        and returns the controller to its one-time-setup-code state, without
        requiring the old password. Unlike
        PVDG_BENCH_ENGINEERING_AUTH_BYPASS this does not remove the
        authentication check itself -- it only gives a way back in when the
        password is lost on a bench unit, the same recovery a genuine forgot-
        password flow would need. The new setup code is logged to the serial
        console only, never returned in the HTTP response, and every use is
        logged with a loud warning.

        This must be 'n' for any build that is reachable outside a closed
        bench network -- it lets anyone on the LAN with no credential at all
        force the controller back into an unauthenticated setup state.

endmenu
```
